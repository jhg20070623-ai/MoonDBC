VERSION ""
NS_ :

BS_:
BU_: ECU
BO_ 291 StandardFrame: 1 ECU
 SG_ Value : 0|8@1+ (1,0) [0|255] "" ECU
BO_ 2147483939 ExtendedFrame: 1 ECU
 SG_ Value : 0|8@1+ (1,0) [0|255] "" ECU
