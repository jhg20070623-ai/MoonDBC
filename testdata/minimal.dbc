BO_ 256 Minimal: 2 ECU
 SG_ IntelValue : 4|12@1+ (0.5,-1) [-1|2047] "km/h" ECU
 SG_ Mode : 0|2@1+ (1,0) [0|3] "" ECU
